## boards/arm/ferne/Kconfig.board
```kconfig
# Copyright (c) 2024 The ZMK Contributors
# SPDX-License-Identifier: MIT

config BOARD_FERNE
	bool "Ferne"
	imply ARM_MPU
	imply GPIO
	imply PINCTRL
	imply ZMK_BLE
	imply BT_CTLR
	imply ZMK_USB
	imply USB_NRFX
	imply ZMK_POWER_DOMAINS
	imply ZMK_POWER_DOMAINS_DYNAMIC_DEFAULT
	imply ZMK_PM_SOFT_OFF
	imply ZMK_GPIO_KEY_WAKEUP_TRIGGER

if BOARD_FERNE

config BOARD_MAX17048
    bool "MAX17048 I2C-based Fuel Gauge"
    imply ZMK_MAX17048
    imply I2C
	depends on DT_HAS_ZMK_MAXIM_MAX17048_ENABLED

config BOARD_BQ25895
	bool "BQ25895 charger"
    imply CHARGER_BQ25895
	# imply ZMK_BATTERY_REPORTING_FETCH_MODE_LITHIUM_VOLTAGE
	default y
	depends on DT_HAS_ZMK_BQ25895_ENABLED

endif # BOARD_FERNE
```

## boards/arm/ferne/Kconfig.defconfig
```kconfig
# Copyright (c) 2024 The ZMK Contributors
# SPDX-License-Identifier: MIT

# https://docs.zephyrproject.org/latest/build/kconfig/setting.html#motivation-for-kconfig-defconfig-files
#   "One motivation for this configuration scheme is to avoid making fixed BOARD-specific 
#    settings configurable in the interactive configuration interfaces."

if BOARD_FERNE
config BOARD_ENABLE_DCDC
    bool "Enable DCDC mode"
    select SOC_DCDC_NRF52X
    default y

config BOARD_ENABLE_DCDC_HV
    bool "High voltage DCDC converter"
    select SOC_DCDC_NRF52X_HV
    default y

endif #BOARD_FERNE
```

## boards/arm/ferne/ferne_defconfig
```kconfig
# Copyright (c) 2025 The ZMK Contributors
# SPDX-License-Identifier: MIT

CONFIG_BOARD_FERNE=y
CONFIG_SOC_SERIES_NRF52X=y
CONFIG_SOC_NRF52840_QIAA=y

# https://github.com/zmkfirmware/zmk/blob/72b00b3f5850c37e26f05725a2688779eba10976/app/Kconfig#L44
CONFIG_NRF_STORE_REBOOT_TYPE_GPREGRET=n

# Build configurations
CONFIG_USE_DT_CODE_PARTITION=y
CONFIG_BUILD_OUTPUT_UF2=y

# Flash configuration
CONFIG_MPU_ALLOW_FLASH_WRITE=y
CONFIG_NVS=y
CONFIG_SETTINGS_NVS=y
CONFIG_FLASH=y
CONFIG_FLASH_PAGE_LAYOUT=y
CONFIG_FLASH_MAP=y

# Enable external 32kHz crystal
CONFIG_CLOCK_CONTROL_NRF_K32SRC_XTAL=y
CONFIG_CLOCK_CONTROL_NRF_K32SRC_150PPM=y
```

## boards/shields/ferne/Kconfig.defconfig
```kconfig
if SHIELD_FERNE_LEFT
    config ZMK_KEYBOARD_NAME
        default "Ferne"

    config ZMK_SPLIT_ROLE_CENTRAL
        default y
endif # SHIELD_FERNE_LEFT

if SHIELD_FERNE_LEFT || SHIELD_FERNE_RIGHT
    config ZMK_SPLIT
        default y

#    if ZMK_RGB_UNDERGLOW
#        config SPI
#            default y
#
#        config WS2812_STRIP
#            default y
#    endif # ZMK_RGB_UNDERGLOW
#
#    if USB
#        config USB_NRFX
#            default y
#
#        config USB_DEVICE_STACK
#            default y
#    endif # USB

    config BT_CTLR
        default BT

#    config ZMK_BLE
#        default y
#
#    config ZMK_USB
#        default y
#    
#    config I2C
#        default y
#
#    config ZMK_MAX17048
#        default y
endif
```

## boards/shields/ferne/Kconfig.shield
```kconfig
# Copyright (c) 2020 Pete Johanson
# SPDX-License-Identifier: MIT

config SHIELD_FERNE_LEFT
    def_bool $(shields_list_contains,ferne_left)

config SHIELD_FERNE_RIGHT
    def_bool $(shields_list_contains,ferne_right)

if SHIELD_FERNE_LEFT || SHIELD_FERNE_RIGHT

config SHIELD_UNDERGLOW
    bool "Per-key RGB"
    imply SPI
    imply WS2812_STRIP
    imply ZMK_RGB_UNDERGLOW
    imply ZMK_RGB_UNDERGLOW_EXT_POWER
    depends on DT_HAS_WORLDSEMI_WS2812_SPI_ENABLED

config SHIELD_SCREEN #TODO: more features
    bool "Skree Display"
    imply SPI
    imply ZMK_DISPLAY
    #imply ZMK_DISPLAY_WORK_QUEUE_DEDICATED
    depends on DT_HAS_SHARP_LS0XX_ENABLED

config SHIELD_TRACKBALL
    bool "PMW3610 trackball"
    imply SPI
    imply PMW3610
    imply ZMK_POINTING
    imply ZMK_POINTING_SMOOTH_SCROLLING
    depends on DT_HAS_PIXART_PMW3610_ENABLED

config SHIELD_ENCODER
    bool "Rotary EC11 encoder"
    imply EC11
    #imply EC11_TRIGGER_GLOBAL_THREAD
    depends on DT_HAS_ALPS_EC11_ENABLED
endif
```

## modules/Kconfig
```kconfig
module = BQ25895
module-str = bq25895
source "${ZEPHYR_BASE}/subsys/logging/Kconfig.template.log_config"

config CHARGER_BQ25895
	bool "BQ25895 Battery Charger"
	default y
	depends on DT_HAS_ZMK_BQ25895_ENABLED
	select I2C
	select CHARGER
	help
	  Enable BQ25895 battery charger driver.

config SK6812_STRIP_I2S
	bool "I2S driver"
	default y
	depends on DT_HAS_ZMK_SK6812_I2S_ENABLED
	select I2S
	help
	  Uses the I2S peripheral, memory usage is 4 bytes per color,
	  times the number of pixels.
```

## modules/dts/bindings/zmk,bq25895.yml
```yaml
description: |
  Charger driver for bq25895 

compatible: "zmk,bq25895"

include: i2c-device.yaml

properties:
  irq-gpios:
    type: phandle-array
    required: true
  
  # (main)
  batlowv:
    type: int
    description: Battery Precharge to Fast Charge Threshold 2800mV-3000mV
    default: 3000
    enum:
    - 2800
    - 3000
  
  iprechg:
    type: int
    description: Precharge Current Limit 64mA - 1024mA 
    default: 128
  
  vreg:
    type: int
    description: Charge Voltage Limit 3840mV - 4608mV
    default: 4208
  
  ichg:
    type: int
    description: Fast Charge Current Limit 0-5056mA
    default: 2048
  
  iterm:
    type: int
    description: Termination Current Limit 64mA - 1024mA
    default: 256
  
  sys_min:
    type: int
    description: Minimum System Voltage Limit 3000mV-3700mV
    default: 3500 #(Vsys == VDDH on nrf, VDDH-VDD>=0.3V, so if VDD=3.3V, Vsys=3.6V)
  
  vrechg:
    type: int
    description: Battery Recharge Threshold Offset 100mV-200mV
    default: 100
  
  treg:
    type: int
    description: Thermal Regulation Threshold 60-120C
    default: 120
  
  bat_comp:
    type: int
    description: IR Compensation Resistor Setting 0-140mOhm
    default: 0
  
  vclamp:
    type: int
    description: IR Compensation Voltage Clamp 0-0.224V
    default: 0
 
  # (features)
  en_hiz:
    type: boolean
    description: Enable HIZ Mode
    # default: false
  
  ico_en:
    type: boolean
    description: Input Current Optimizer (ICO) Enable
    #default: true
  
  hvdcp_en:
    type: boolean
    description: High Voltage DCP Enable
    #default: true
  
  maxc_en:
    type: boolean
    description: MaxCharge Adapter Enable
    #default: true
  
  auto_dpdm_en:
    type: boolean
    description: Automatic D+/D- Detection Enable when VBUS plugged in
    #default: true
  
  bat_loaden:
    type: boolean
    description: Battery Load (IBATLOAD) Enable
    # default: false
  
  chg_config:
    type: boolean
    description: Charge Enable Configuration (Battery charging is enabled by setting CHG_CONFIG bit, /CE pin is low and ICHG register is not 0 mA)
    #default: true
  
  en_term:
    type: boolean
    description: Charging Termination Enable
    #default: true
  
  batfet_dly:
    type: boolean
    description: BATFET turn off delay control, tSM_DLY=10s-15s
    #default: (off, no delay) 
  
  batfet_rst_en:
    type: boolean
    description: BATFET full system reset enable
    #default: (enabled)
  
  # (input voltage/current)
  iinlim:
    type: int
    description: Input Current Limit 0.1A-3.5A, changed automaticallly after input source type detection is completed
    default: 500
  
  vindpm_os:
    type: int
    description: Input Voltage Limit Offset 0V - 3.1V, used to calculate VINDPM threshold
    default: 500
  
  force_vindpm:
    type: boolean
    description: VINDPM Threshold Setting Method
    # default: false
  
  vindpm:
    type: int
    description: Absolute VINDPM Threshold 3.9V - 15.3V
    default: 4400
  
  # (pins)
  en_ilim:
    type: boolean
    description: Enable ILIM Pin
    #default: true
  
  stat_dis:
    type: boolean
    description: STAT Pin Disable
    #default: (pin enabled)
  # (timers)
  watchdog:
    type: int
    description: I2C Watchdog Timer Setting disabled-160s
    default: 0
    enum:
    - 0
    - 40
    - 80
    - 160 #120?
  
  en_timer:
    type: boolean
    description: Charging Safety Timer Enable
    #default: true
  
  chg_timer:
    type: int
    description: Fast Charge Timer Setting 5hrs-20hrs
    default: 12
    enum:
    - 5
    - 8
    - 12
    - 20
  
  tmr2x_en:
    type: boolean
    description: Safety Timer Setting during DPM or Thermal Regulation
    # default: true (slowed down by 2X)
  
  # (boost)
  bcold:
    type: int
    description: Boost Mode Cold Temperature Monitor Threshold
    default: 77
    enum:
    - 77
    - 80
  
  # bhot:
  #   type: int
  #   description: Boost Mode Hot Temperature Monitor Threshold
  #   default: (34.75%)
  
  boost_freq:
    type: int
    description: Boost Mode Frequency Selection
    default: 500
    enum:
    - 500
    - 1500
  
  otg_config:
    type: boolean
    description: Boost (OTG) Mode Configuration
    #default: true
  
  boostv:
    type: int
    description: Boost Mode Voltage Regulation 4.55V - 5.51V
    default: 5126
  
  # (pumpx)
  en_pumpx:
    type: boolean
    description: Current pulse control Enable
    # default: false
  
  pumpx_up:
    type: boolean
    description: Current pulse control voltage up enable
    # default: false
  
  pumpx_dn:
    type: boolean
    description: Current pulse control voltage down enable
    # default: false


# Stage 1: pre-charge IPRECHARGE (until BATLOWV (2.8V/3V))
# Stage 2: constant current (until Charge V = 4.2V)
# Stage 3: constant voltage (until 0.02C = 68mA; cut off sooner for longer life)
# Stage 4: discarge (until 2.65V; )
# - status notifications to LEDs?
# - poweroff on low voltage and idle
```

## modules/dts/bindings/zmk,sk6812-i2s.yml
```yaml
description: |
  Charger driver for sk6812 using i2s 

compatible: "zmk,sk6812-i2s"

include: base.yaml

properties:
  i2s-dev:
    type: phandle
    required: true
    description: Pointer to the I2S instance.
    
  chain-length:
    type: int
    required: true
    description: |
      The number of devices in the daisy-chain.

  color-mapping:
    type: array
    required: true
    description: |
      Channel to color mapping (or pixel order).

      For example a GRB channel to color mapping would be

         color-mapping = <LED_COLOR_ID_GREEN
                          LED_COLOR_ID_RED
                          LED_COLOR_ID_BLUE>;

  reset-delay:
    type: int
    default: 50
    description: |
      Minimum delay to wait (in microseconds) between frames
```
